## conf/layer.conf
```bitbake
# We have a conf and classes directory, add to BBPATH
BBPATH .= ":${LAYERDIR}"

# We have recipes-* directories, add to BBFILES
BBFILES += "${LAYERDIR}/recipes-*/*/*.bb \
            ${LAYERDIR}/recipes-*/*/*.bbappend"

BBFILE_COLLECTIONS += "cy5976"
BBFILE_PATTERN_cy5976 = "^${LAYERDIR}/"
BBFILE_PRIORITY_cy5976 = "10"
LAYERVERSION_cy5976 = "4"
LAYERSERIES_COMPAT_cy5976 = "scarthgap"

# Add the BIOS option to load u-boot from the correct location
EXTRA_QEMUOPTS += "-bios ${DEPLOY_DIR_IMAGE}/u-boot.bin"

EXTRA_QEMUOPTS += "-drive file=${DEPLOY_DIR_IMAGE}/core-image-base-qemuarm-uboot.wic.qcow2,if=virtio,format=qcow2"

# Add TPM and other QEMU options (modify as needed)
EXTRA_QEMUOPTS += "-chardev socket,id=chrtpm,path=/tmp/mytpm1/swtpm-sock \
-tpmdev emulator,id=tpm0,chardev=chrtpm \
-device tpm-tis-device,tpmdev=tpm0"

# Additional custom QEMU options (if needed)
EXTRA_QEMUOPTS += "-nographic"
```
